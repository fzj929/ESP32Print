## hp2300_print_idf/main/Kconfig.projbuild
```kconfig
menu "mybips printer gateway"

    config BIPS_DEVELOPMENT_MODE
        bool "Enable unprovisioned printer testing and development-only password recovery"
        default n
        help
            This mode permits manual printing without a provisioned eFuse identity
            and permits GPIO4 to restore the shared initial password. It is unsafe
            for production. Disable it in a production configuration; printing
            then fails closed until the certificate-bound identity and recovery
            flow are implemented and verified.

endmenu
```

## hp2300_print_idf/sdkconfig.defaults
```kconfig
CONFIG_IDF_TARGET="esp32s3"
CONFIG_ESP_CONSOLE_UART_DEFAULT=y
CONFIG_ESP_CONSOLE_UART_BAUDRATE=115200
CONFIG_ESP_CONSOLE_SECONDARY_NONE=y
CONFIG_LOG_DEFAULT_LEVEL_INFO=y
CONFIG_LOG_MAXIMUM_LEVEL_DEBUG=y
CONFIG_LOG_COLORS=n
CONFIG_ESP_MAIN_TASK_STACK_SIZE=8192
CONFIG_USB_HOST_CONTROL_TRANSFER_MAX_SIZE=1024
CONFIG_ESPTOOLPY_FLASHSIZE_16MB=y
CONFIG_PARTITION_TABLE_CUSTOM=y
CONFIG_PARTITION_TABLE_CUSTOM_FILENAME="partitions.csv"
CONFIG_SPIRAM=y
CONFIG_SPIRAM_MODE_OCT=y
CONFIG_SPIRAM_USE_MALLOC=y
CONFIG_BIPS_DEVELOPMENT_MODE=y
```
